## Kconfig
```kconfig
#------------------------------------------------#
#       General configuration options
#------------------------------------------------#

mainmenu "Yunetas Kernel Configuration"

#------------------------------#
#   Compiler
#------------------------------#
choice
    prompt "Compiler Selection"
    default USE_COMPILER_GCC

config USE_COMPILER_GCC
    bool "GCC compiler"
    help
        Select GCC as the compiler.

config USE_COMPILER_CLANG
    bool "Clang compiler"
    help
        Select Clang as the compiler.

config USE_COMPILER_MUSL
    bool "Musl compiler"
    help
        Select Musl as the compiler.

endchoice

#------------------------------#
#   Build Configuration
#------------------------------#
choice
    prompt "Build Type"
    default BUILD_TYPE_RELEASE

config BUILD_TYPE_RELEASE
    bool "Release"
    help
        Use CMake Build Type 'Release'.
        Optimized build, no debug info.

config BUILD_TYPE_DEBUG
    bool "Debug"
    help
        Use CMake Build Type 'Debug'.
        Full debug info, no optimization.

config BUILD_TYPE_RELWITHDEBINFO
    bool "RelWithDebInfo"
    help
        Use CMake Build Type 'RelWithDebInfo'.
        Optimized with debug info.

config BUILD_TYPE_MINSIZEREL
    bool "MinSizeRel"
    help
        Use CMake Build Type 'MinSizeRel'.
        Optimized for small binary size.

endchoice

#------------------------------#
#   TLS libraries
#------------------------------#
choice
    prompt "TLS Library"
    default HAVE_OPENSSL

config HAVE_OPENSSL
    bool "OpenSSL"
    help
        Use OpenSSL as a TLS library to the YTLS API and libjwt.

config HAVE_MBEDTLS
    bool "Mbed-TLS"
    help
        Use mbed-tls as a TLS library to the YTLS API and libjwt.

endchoice

#------------------------------#
#   Debug
#------------------------------#
menu "Debug Options"

config DEBUG_WITH_BACKTRACE
    bool "Use backtrace library"
    default y
    help
        Use backtrace library to print stack trace

config DEBUG_PRINT_YEV_LOOP_TIMES
    bool "Print times of yev_loop"
    default n
    help
        Enable print of elapsed times of several points in yev_loop

config DEBUG_TRACK_MEMORY
    bool "Enable track memory"
    default n
    help
        Enable track memory to find leaks

endmenu

#------------------------------#
#   Modules
#------------------------------#
menu "Modules"
source "modules/c/Kconfig"
endmenu
```

## Kconfig.yunetas
```kconfig
menu "Yunetas Configuration"

source "Kconfig.compiler"

menu "Modules"
source "modules/c/Kconfig"
endmenu

endmenu
```

## core-esp32/components/esp_c_prot/Kconfig
```kconfig
menu "Yuneta GC Protocol"
    config YUNETA_MODBUS_MASTER
        bool "Include Yuneta Modbus master protocol"
        default n
        help
            Include Yuneta Modbus master protocol
endmenu
```

## core-esp32/components/esp_yuneta/Kconfig
```kconfig
menu "Yuneta"
    source "/yuneta/development/yuneta/yunetas/core-esp32/components/esp_c_prot/Kconfig.protocols"

    config INCLUDE_YUNETA_UART
        bool "Include Yuneta UART c_esp_uart.c"
        default y
        help
            Include Yuneta UART

    if INCLUDE_YUNETA_UART
        source "/yuneta/development/yuneta/yunetas/core-esp32/components/esp_yuneta/Kconfig.uart"
    endif

    config INCLUDE_YUNETA_ETHERNET
        bool "Include Yuneta ETHERNET c_esp_ethernet.c"
        default y
        help
            Include Yuneta ETHERNET

    if INCLUDE_YUNETA_ETHERNET
        source "/yuneta/development/yuneta/yunetas/core-esp32/common_components/olimex-gateway/Kconfig.ethernet"
    endif

endmenu
```

## defconfig
```kconfig
CONFIG_USE_COMPILER_GCC=y
CONFIG_FULLY_STATIC=y
CONFIG_BUILD_TYPE_DEBUG=y
CONFIG_C_PROT=y
```

## kernel/c/root-esp32/components/esp_yuneta/Kconfig
```kconfig
menu "Yuneta"
    source "/yuneta/development/yuneta/yunetas/kernel/c/root-esp32/components/esp_c_prot/Kconfig.protocols"

    config INCLUDE_YUNETA_UART
        bool "Include Yuneta UART c_esp_uart.c"
        default y
        help
            Include Yuneta UART

    if INCLUDE_YUNETA_UART
        source "/yuneta/development/yuneta/yunetas/kernel/c/root-esp32/components/esp_yuneta/Kconfig.uart"
    endif

    config INCLUDE_YUNETA_ETHERNET
        bool "Include Yuneta ETHERNET c_esp_ethernet.c"
        default y
        help
            Include Yuneta ETHERNET

    config INCLUDE_YUNETA_WIFI
        bool "Include Yuneta WIFI c_esp_wifi.c"
        default y
        help
            Include Yuneta WIFI

    if INCLUDE_YUNETA_ETHERNET
        source "/yuneta/development/yuneta/yunetas/kernel/c/root-esp32/components/esp_yuneta/Kconfig.ethernet"
    endif

endmenu
```

## kernel/c/root-esp32/components/esp_yuneta/Kconfig.uart
```kconfig
menu "Yuneta UART"
    source "/yuneta/development/yuneta/yunetas/kernel/c/root-esp32/common_components/env_caps/$IDF_TARGET/Kconfig.env_caps"

    choice YUNETA_SERIAL_PORT
        prompt "Select Serial port"
        #default YUNETA_USE_DB9 # changed by configuration of 'Console output'
        help
            Select the serial port: USB or external DB9 conector
        config YUNETA_USE_USB
            bool "USB port [To change you must configure 'Console output' to Default: UART0)]"
            depends on ESP_CONSOLE_NONE=y
        config YUNETA_USE_DB9
            bool "DB9 port [To change you must configure 'Console output' to None]"
            depends on ESP_CONSOLE_NONE=n
    endchoice # YUNETA_SERIAL_PORT

    if YUNETA_USE_DB9
        config YUNETA_UART_BAUDRATE
            int "Baud Rate"
            default 9600
            help
                Set the UART baudrate (default 9600)
        #config YUNETA_UART_NUMBER
        #    int "UART Number"
        #    default 3
        #    help
        #        Set the UART number used to RS232, default 3
        #config YUNETA_UART_TX
        #    int "GPIO TX"
        #    default 17
        #    help
        #        Set the GPIO number used to UART TX, default 17
        #config YUNETA_UART_RX
        #    int "GPIO RX"
        #    default 16
        #    help
        #        Set the GPIO number used to UART RX, default 16

    endif # YUNETA_USE_DB9

    if YUNETA_USE_USB
        config YUNETA_UART_BAUDRATE
            int "Baud Rate"
            default 9600
            help
                Set the UART baudrate (default 9600)
        #config YUNETA_UART_NUMBER
        #    int "UART Number"
        #    default 0
        #    help
        #        Set the UART number used to RS232, default 0
        #config YUNETA_UART_TX
        #    int "GPIO TX"
        #    default 1
        #    help
        #        Set the GPIO number used to UART TX, default 1
        #config YUNETA_UART_RX
        #    int "GPIO RX"
        #    default 3
        #    help
        #        Set the GPIO number used to UART RX, default 3

    endif # YUNETA_USE_USB

endmenu
```

## modules/c/Kconfig
```kconfig
comment "Available modules."

source "modules/c/console/Kconfig"
source "modules/c/mqtt/Kconfig"
source "modules/c/postgres/Kconfig"
source "modules/c/test/Kconfig"
```

## modules/c/c_console/Kconfig
```kconfig
config C_CONSOLE_MODULE
    bool

config C_CONSOLE
    bool "C_CONSOLE support"
    default y
    help
      This option enables the C_CONSOLE library.
```

## modules/c/c_mqtt/Kconfig
```kconfig
config C_MQTT_MODULE
    bool

config C_PROT_MQTT2
    bool "C_PROT_MQTT2 support"
    default y
    help
      This option enables the C_PROT_MQTT2 gclass.

config C_MQTT_BROKER
    bool "C_MQTT_BROKER support"
    default y
    help
      This option enables the C_MQTT_BROKER gclass.
```

## modules/c/c_postgres/Kconfig
```kconfig
config C_POSTGRES_MODULE
    bool

config C_POSTGRES
    bool "C_POSTGRES support"
    default y
    help
      This option enables the C_POSTGRES library.
```

## modules/c/c_prot/Kconfig
```kconfig
config C_PROT_MODULE
    bool

config C_PROT
    bool "C_PROT support"
    default y
    help
      This option enables the C_PROT library.

if C_PROT

config C_PROT_MQTT
    bool "MQTT protocol support (c_prot_mqtt2)"
    default y
    help
      Enable the MQTT v3.1.1/v5.0 protocol implementation (c_prot_mqtt2,
      mqtt_util, tr2q_mqtt). Disable to exclude MQTT from the C_PROT build.

endif # C_PROT
```

## modules/c/console/Kconfig
```kconfig
config MODULE_CONSOLE
    bool "MODULE_CONSOLE support"
    default y
    help
      This option enables the C_EDITLINE gclass.
```

## modules/c/modbus/Kconfig
```kconfig
config MODULE_MODBUS
    bool "MODULE_MODBUS support"
    default y
    help
      This option enables the C_PROT_MODBUS_M gclass.
```

## modules/c/mqtt/Kconfig
```kconfig
config MODULE_MQTT
    bool "MODULE_MQTT support"
    default y
    help
      This option enables the C_PROT_MQTT2,C_MQTT_BROKER gclass.
```

## modules/c/postgres/Kconfig
```kconfig
config MODULE_POSTGRES
    bool "MODULE_POSTGRES support"
    default y
    help
      This option enables the C_POSTGRES gclass.
```

## modules/c/test/Kconfig
```kconfig
config MODULE_TEST
    bool "MODULE_TEST support"
    default y
    help
      This option enables the C_PEPON,C_TESTON gclass.
```
